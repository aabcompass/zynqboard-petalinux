/*
 * CAUTION: This file is automatically generated by PetaLinux SDK.
 * DO NOT modify this file
 */


/ {
	chosen {
		bootargs = "console=ttyPS0,115200 earlyprintk";
		stdout-path = "serial0:115200n8";
	};
};

&gem0 {
	local-mac-address = [00 0a 35 00 1e 53];
};

