/include/ "system-conf.dtsi"
/ {
	// Andrey Poroshin added pseudo device for DMA access
	dma_proxy {
		compatible ="por,dma-proxy-pseudo-dev";
		dmas = <&axi_dma_0 0
				&axi_dma_sc36 0>;

		dma-names = "axi_dma_0", "axi_dma_sc36";
	};
	
};

//Andrey Poroshin added "spidev" support
&axi_quad_spi_0 {
	#address-cells=<1>;
	#size-cells=<0>;
	spidev0: spidev@0{
		compatible = "artix-bsdata-port";
		reg = <0>; //chipselect 0
		spi-max-frequency = <6250000>;
	};
};
